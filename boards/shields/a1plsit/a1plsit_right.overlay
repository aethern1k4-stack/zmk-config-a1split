// This file was generated from a template. Edit it to match your keyboard.
// See https://zmk.dev/docs/development/hardware-integration/new-shield for more
// instructions.

#include "a1plsit.dtsi"

&default_transform {
    // Set this to the number of columns on the left side.
    col-offset = <5>;
};

&kscan {
    // Replace these comments with the GPIO pins in the matrix for the right side.
    // See https://zmk.dev/docs/development/hardware-integration/new-shield#shield-overlays
    col-gpios
        = <&gpio 3 GPIO_ACTIVE_HIGH>
        , <&gpio 28 GPIO_ACTIVE_HIGH>
        , <&gpio 29 GPIO_ACTIVE_HIGH>
        , <&gpio 4 GPIO_ACTIVE_HIGH>
        , <&gpio 5 GPIO_ACTIVE_HIGH>
        , <&gpio 9 GPIO_ACTIVE_HIGH>
        ;
};
