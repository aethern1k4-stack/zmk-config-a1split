## boards/shields/a160/Kconfig.defconfig
```kconfig
if SHIELD_A160

config ZMK_KEYBOARD_NAME
    default "A160"

endif # SHIELD_A160
```

## boards/shields/a1mag/Kconfig.defconfig
```kconfig
if SHIELD_A1MAG

config ZMK_KEYBOARD_NAME
    default "A1MAG"

endif # SHIELD_A1MAG
```

## boards/shields/a1plsit/Kconfig.defconfig
```kconfig
if SHIELD_A1PLSIT_LEFT

config ZMK_KEYBOARD_NAME
    default "A1split"

config ZMK_SPLIT_ROLE_CENTRAL
    default y

endif # SHIELD_A1PLSIT_LEFT

if SHIELD_A1PLSIT_LEFT || SHIELD_A1PLSIT_RIGHT

config ZMK_SPLIT
    default y

endif # SHIELD_A1PLSIT_LEFT || SHIELD_A1PLSIT_RIGHT
```

## boards/shields/a1plsit/Kconfig.shield
```kconfig
config SHIELD_A1PLSIT_LEFT
    def_bool $(shields_list_contains,a1plsit_left)

config SHIELD_A1PLSIT_RIGHT
    def_bool $(shields_list_contains,a1plsit_right)
```
